RESET
SYStem.JtagClock 500khz

SYStem.CPU CORTEXA76A55
SYStem.CONFIG CORENUMBER 8.

SYStem.CONFIG.APBAP1.Base     DP:0x00080000
SYStem.CONFIG.AXIAP1.Base     DP:0x000A0000


; Addressing scheme:            <big-A76-0>  <little-A55-0>   <big-A76-1>  <little-A55-1>  <big-A76-2>  <dummy>   <big-A76-3>  <dummy>
SYStem.CONFIG.COREDEBUG.Base  APB:0x01210000 APB:0x01010000 APB:0x01310000 APB:0x01110000 APB:0x01410000 APB:0x0 APB:0x01510000 APB:0x0
SYStem.CONFIG.CTI.Base        APB:0x01220000 APB:0x01020000 APB:0x01320000 APB:0x01120000 APB:0x01420000 APB:0x0 APB:0x01520000 APB:0x0


core.ASSIGN.BIGLITTLE 1. 2. 3. 4. 5. NONE 7. NONE

; select A55-0
core.select 01

SYStem.Attach

Break
ENDDO