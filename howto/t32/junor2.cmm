SYStem.JtagClock 50Mhz

SYStem.CONFIG Slave ON
SYStem.CPU CORTEXA72A53
SYStem.CONFIG CORENUMBER 8.

; Access port numbers are
;SYStem.CONFIG APBACCESSPORT 1.
;SYStem.CONFIG DEBUGACCESSPORT 1.
;SYStem.CONFIG AXIACCESSPORT 0.
;SYStem.CONFIG MEMORYACCESSPORT 0.

; Pre/Post settings
SYStem.CONFIG DAPIRPRE 4.
SYStem.CONFIG DAPDRPRE 1.
SYStem.CONFIG DAPIRPOST 0.
SYStem.CONFIG DAPDRPOST 0.

; Assignment: big_1 LITTLE_1 big_2 LITTLE_2 etc. Non-existing cores get a dummy value
SYStem.CONFIG COREDEBUG BASE  DAP:0x82010000 DAP:0x83010000 DAP:0x82110000 DAP:0x83110000 DAP:0x0 DAP:0x83210000 DAP:0x0 DAP:0x83310000
SYStem.CONFIG CTI BASE        DAP:0x82020000 DAP:0x83020000 DAP:0x82120000 DAP:0x83120000 DAP:0x0 DAP:0x83220000 DAP:0x0 DAP:0x83320000

SYStem.CONFIG STM Base DAP:0x80100000
SYStem.CONFIG STM.Type ARM
SYStem.CONFIG STM.Mode STPv2

CORE.ASSIGN BIGLITTLE 1. 2. 3. 4. NONE 6. NONE 8.

ENDDO