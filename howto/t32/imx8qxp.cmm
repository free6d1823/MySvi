SYStem.JtagClock 10Mhz

SYStem.CPU CORTEXA35
SYStem.CONFIG CORENUMBER 4.

; Access port numbers are
SYStem.CONFIG APBACCESSPORT 4.
SYStem.CONFIG DEBUGACCESSPORT 4.
SYStem.CONFIG AXIACCESSPORT 0.
SYStem.CONFIG MEMORYACCESSPORT 0.

; Pre/Post settings
SYStem.CONFIG DAPIRPRE 0.
SYStem.CONFIG DAPDRPRE 0.
SYStem.CONFIG DAPIRPOST 0.
SYStem.CONFIG DAPDRPOST 0.

SYStem.CONFIG COREDEBUG BASE DAP:0x80410000 DAP:0x80510000 DAP:0x80610000 DAP:0x80710000
SYStem.CONFIG CTI BASE       DAP:0x80420000 DAP:0x80520000 DAP:0x80620000 DAP:0x80720000

SYStem.CONFIG STM Base DAP:0x80100000
SYStem.CONFIG STM.Type ARM
SYStem.CONFIG STM.Mode STPv2

CORE.ASSIGN 1. 2. 3. 4.

ENDDO