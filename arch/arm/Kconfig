## arch/arm/Kconfig
```kconfig
mainmenu "ARM 32bit Configuration"

source "init/Kconfig-m4.main"

config ARM
	bool
	default y
	select COMMON_C_LIB
	select ARCH_HAS_IRQC
	select ARCH_HAS_GICv3
	help

menu "ARM system options"
source "arch/arm/common/Kconfig"
endmenu

source "drivers/Kconfig"
source "lib/Kconfig"
source "init/Kconfig"
```

## arch/arm/common/Kconfig
```kconfig
# Cortex-R52
config CPU_CORTEX_R52
	bool
	default y
	select CPU_V8R
	help

# Figure out what processor architecture version we should be using.
# This defines the compiler instruction set which depends on the machine type.

config CPU_V8R
	bool

config CPU_v7
	bool

config NR_CPUS
	int "Maximum number of CPUs (1-4)"
	range 1 4
	# These have to remain sorted largest to smallest
	default "4"

config GIC
	bool "Generic Interrupt Controller (GIC)"
	depends on CPU_V8R
	select ARCH_HAS_IRQC
	help
	  The GIC architecture describes an interrupt controller for use with
	  one or more processors that comply with ARM A or R architecture
	  profiles.

if GIC

config ARCH_HAS_GICv3
	bool

config GICv3
	bool "GICv3 support"
	depends ARCH_HAS_GICv3
	help
	  GIC v3 (IHI0069D) architecture specification.

endif
```

## arch/arm64/common/Kconfig
```kconfig
# QDF2400
config CPU_QDF2400
	bool
	select CPU_64v8
	select CPU_v80A
	help
	  1 Cortex-A53 (IMC) + many Cortex-A57 (APC).

# Figure out what processor architecture version we should be using.
# This defines the compiler instruction set which depends on the machine type.

config CPU_64v8
	bool

config CPU_v80A
	bool

config CPU_v81A
	bool

config CPU_v82A
	bool

config CPU_BIG_ENDIAN
	bool "Build big-endian firmware"
	depends on ARCH_SUPPORTS_BIG_ENDIAN
	help
	  Say Y if you plan on running a kernel in big-endian mode.
	  Note that your board must be properly built and your board
	  port must properly enable any big-endian related features
	  of your chipset/board/processor.

config MINI_EXCLUSIVE_ACCESS
	bool
	help
	  Say Y if the running RAM doesn't support exclusives monitor.

config NR_CPUS
	int "Maximum number of CPUs (1-4096)"
	range 1 4096
	# These have to remain sorted largest to smallest
	default "48"

config GIC
	bool "Generic Interrupt Controller (GIC)"
	depends on CPU_64v8
	select ARCH_HAS_IRQC
	help
	  The GIC architecture describes an interrupt controller for use with
	  one or more processors that comply with ARM A or R architecture
	  profiles.

if GIC

config ARCH_HAS_GICv2
	bool

config ARCH_HAS_GICv3
	bool

config GICv2
	bool "GICv2 support"
	depends ARCH_HAS_GICv2
	help
	  GIC v2 (IHI0028B) architecture specification.

config GICv3
	bool "GICv3 support"
	depends ARCH_HAS_GICv3
	help
	  GIC v3 (IHI0069D) architecture specification.

config GIC600
	bool "GIC600 support"
	depends ARCH_HAS_GICv3
	help
	  GIC600 ip.

endif

config DCC
	bool "Debug Communications Channel (DCC)"
	select ARCH_HAS_UART
	select IRQ_FORBIDDEN
	help
	  The Debug Communications Channel, DCC, is a channel for passing
	  data between the PE and an external agent, such as a debugger.
	  The DCC provides a communications channel between:
	  * An external debugger, described as the debug host.
	  * The debug implementation on the PE, described as the debug
	    target.
	  The DCC can be used:
	  * As a 32-bit full-duplex channel.
	  * As a 64-bit half-duplex channel.
	  The DCC is an essential part of Debug state operation and can
	  also be used in Non-debug state.
	  The driver currently only support IRQ polling.

config CONSOLE_IMC_BUFFERING
	bool "IMC outputs to the APC buffer"
	depends DEBUG_DCC
	depends CONSOLE_OUTPUT

config CORESIGHT
	bool "ARM CoreSight architecture support"

if CORESIGHT

config CORESIGHT_VERBOSE
	bool "Enable log verbosity"
	help
	  Print detailed enumeration logs.

config CORESIGHT_DBG_CPUv80A
	bool "ARM CoreSight Processor Core v8.0A Debug support"
	depends CPU_v80A
	help
	  DEVARCH.archid=0x6A15.

config CORESIGHT_ETM
	bool "ARM CoreSight Embedded Trace Macrocell (ETM) support"
	help
	  DEVARCH.archid=0x4A13.

config CORESIGHT_STM
	bool "ARM CoreSight System Trace Macrocell (STM) support"
	help
	  DEVARCH.archid=0x0A63.

config CORESIGHT_PMU
	bool "ARM CoreSight Performance Monitor Unit (PMU) support"
	help
	  DEVARCH.archid=0x2A16.

config CORESIGHT_CTI
	bool "ARM CoreSight Cross Trigger Interface (CTI) support"

config CORESIGHT_TPIU
	bool "ARM CoreSight Trace Port Interface Unit (TPIU) support"
	help
	  DEVTYPE.major=1, DEVTYPE.sub=1.

config CORESIGHT_ETB
	bool "ARM CoreSight Embedded Trace Buffer (ETB) support"
	help
	  DEVTYPE.major=1, DEVTYPE.sub=2.

config CORESIGHT_FUNNEL
	bool "ARM CoreSight Funnel/Router support"
	help
	  DEVTYPE.major=2, DEVTYPE.sub=1.

config CORESIGHT_REPLICATOR
	bool "ARM CoreSight Replicator support"
	help
	  DEVTYPE.major=2, DEVTYPE.sub=2.

config CORESIGHT_TMC
	bool "ARM CoreSight Trace Memory Controller (TMC) support"
	help
	  DEVTYPE.major=2, DEVTYPE.sub=3.

endif

config MMU
	bool "Memory Management Unit (MMU)"

if MMU

config MMU_SELF_MODIFY
	bool "Enable self modify"

config MMU_DEBUG
	bool "Enable MMU debugging messages"
	depends EXPERIMENTAL

config MMU_FAST
	bool "Enable fast MMU with predefined pagetable"
	help
		pagetable is defined in pagetable.c"
endif

config DATA_BASE
	hex "configure data base"
	default "0x0"

config HEAP_BASE
	hex "configure heap base"
	default "0x0"
```

## arch/arm64/mach-qdf2400/monaco/Kconfig
```kconfig
#
# For a description of the syntax of this configuration file,
# see scripts/kbuild/config-language.txt.
#

menuconfig MONACO
	bool "Qualcomm ring bus (Monaco) support"
	help
	  QDF2400 has Monaco subsystem.

if MONACO

config MONACO_RING
	bool "Monoco ring support"
	help
	  Select ring bus.

config MONACO_MEMORY
	bool "Monaco memory support"
	select MONACO_RING
	help
	  Select ddr controller and ddr phy.

config MONACO_CACHE
	bool "Monaco cache support"
	select MONACO_RING
	help
	  Select L3 cache.

endif
```

## arch/arm64/mach-se1000/Kconfig
```kconfig
#
# For a description of the syntax of this configuration file,
# see scripts/kbuild/config-language.txt.
#

if ARCH_SE1000

menu "SE1000 board options"

endmenu

endif
```

## arch/arm64/mach-virt/Kconfig
```kconfig
#
# For a description of the syntax of this configuration file,
# see scripts/kbuild/config-language.txt.
#

if ARCH_VIRT

menu "Qemu virt board options"

endmenu

endif
```

## arch/arm64/plat-centriq/Kconfig
```kconfig
#
# For a description of the syntax of this configuration file,
# see scripts/kbuild/config-language.txt.
#

if ARCH_CENTRIQ

menu "Qualcomm Centriq platform options"

menu "Power management support"

config PMIC_SPMI
	bool "SPMI based QDF2400 PMIC Arbiter support"

config PMIC_PMBUS
	bool "PMBUS based QDF2400 PMIC (CVR) support"
	select I2C

endmenu

config QCOM_DDRSS
	bool "Qualcomm DDR subsystem (DDRSS) support"
	select MONACO
	select MONACO_MEMORY
	select I2C

config TCM
	bool "L3 Tightly Coupled Memory (TCM) support"
	select MONACO
	select MONACO_CACHE
	select MONACO_SLAVE_CACHE

source "arch/arm64/plat-centriq/monaco/Kconfig"

config GPIO_TLMM
	bool "Qualcomm Top Level Module Multiplexer (TLMM) support"


config I2C_QUP
	bool "Qualcomm Universal Peripheral (QUP) I2C support"

config SPI_QUP
	bool "Qualcomm Universal Peripheral (QUP) SPI support"

config QDSS
	bool "Qualcomm Debug Subsystem (QDSS) support"

if QDSS

config QDSS_CTI
	bool "Qualcomm Cross Trigger Interface (QCOM CTI) support"

config QDSS_PMU
	bool "Qualcomm Performance Monitor Unit (QCOM PMU) support"

config QDSS_DBG
	bool "Qualcomm Debug component support"
	help
	  DEVTYPE.major=4, DEVTYPE.sub=0.

config QDSS_TPDA
	bool "Trace, Performance Monitoring & Diagnostics Aggregator (TPDA) support"

config QDSS_TPDM
	bool "Trace, Profiling & Diagnostics Monitor (TPDM) support"

config QDSS_SWITCH_DBG
	bool "Qualcomm switch debugger support"

config QDSS_SWITCH_PMU
	bool "Qualcomm switch performance monitor support"

config QDSS_SWITCH_CFG
	bool "Qualcomm switch configuration support"
	help
	  DFTSU config.

config QDSS_SKITTER_CFG
	bool "Qualcomm skitter configuration support"

endif

config SPM_CFG
	bool "Subsystem Power Manager (SPM) support"

config FUSE_CFG
	bool "Fuse Print Function support"
endmenu

endif
```

## arch/arm64/plat-centriq/monaco/Kconfig
```kconfig
#
# For a description of the syntax of this configuration file,
# see scripts/kbuild/config-language.txt.
#

menuconfig MONACO
	bool "Qualcomm ring bus (Monaco) support"
	help
	  QDF2400 has Monaco subsystem.

if MONACO

config MONACO_RING
	bool "Monoco ring support"
	help
	  Select ring bus.

config MONACO_SLAVE_CACHE
	bool "Enable slave cache support"

config MONACO_USE_PSEUDO_DDR_CHAN_MASK
	bool "Enable pseudo DDR channel support"

config MONACO_DDR_CHAN_MASK
	hex "DDR channel mask" if MONACO_USE_PSEUDO_DDR_CHAN_MASK

config MONACO_MEMORY
	bool "Monaco memory support"
	select MONACO_RING
	help
	  Select ddr controller and ddr phy.

config MONACO_CACHE
	bool "Monaco cache support"
	select MONACO_RING
	help
	  Select L3 cache.

endif
```

## arch/armv7m/Kconfig
```kconfig
#
# For a description of the syntax of this configuration file,
# see Documentation/kbuild/kconfig-language.txt.
#

mainmenu "Open Kernel Lab L4 Kernel Configuration"

source "init/Kconfig-m4.main"

config ARMV7M
	bool
	default y
	help

menu "ARMV7M system options"

choice
	prompt "ARMV7M system type"
	default ARCH_CORTEXM4

config ARCH_CORTEXM4
	bool "cortex-m4 soc"
	select ARCH_HAS_UART
	select ARCH_HAS_IRQC
	select NVIC if IRQ
	select SOC_CORTEXM4
	select M4BENCH
	help
	  This enables support for cortex-m4 platform.

endchoice


config ARMV7M_NO_PRINT_64BIT
	bool "Not Support 64bit Print"
	default y
	help
	  This enables support for print 64 bit on armv7m platform.

source arch/armv7m/common/Kconfig

endmenu

source "arch/armv7m/mach-cortexm4/Kconfig"

source "drivers/Kconfig"
#source "tests/Kconfig"
source "lib/Kconfig"
source "init/Kconfig"
```

## arch/armv7m/common/Kconfig
```kconfig
# CORTEXM4
config SOC_CORTEXM4
	bool
	select CPU_armv7m
	help
	  1 Cortex-m4 soc.

# Figure out what processor architecture version we should be using.
# This defines the compiler instruction set which depends on the machine type.

config CPU_armv7m
	bool

config NVIC
	bool "NVIC support"
	depends on CPU_armv7m
	help
	  NVIC supported.

config DCC
	bool "Debug Communications Channel (DCC)"
	select ARCH_HAS_UART
	select IRQ_FORBIDDEN
	help
	  The Debug Communications Channel, DCC, is a channel for passing
	  data between the PE and an external agent, such as a debugger.
	  The DCC provides a communications channel between:
	  * An external debugger, described as the debug host.
	  * The debug implementation on the PE, described as the debug
	    target.
	  The DCC can be used:
	  * As a 32-bit full-duplex channel.
	  * As a 64-bit half-duplex channel.
	  The DCC is an essential part of Debug state operation and can
	  also be used in Non-debug state.
	  The driver currently only support IRQ polling.

config CONSOLE_IMC_BUFFERING
	bool "IMC outputs to the APC buffer"
	depends DEBUG_DCC
	depends CONSOLE_OUTPUT
```

## arch/armv7m/mach-cortexm4/Kconfig
```kconfig
#
# For a description of the syntax of this configuration file,
# see scripts/kbuild/config-language.txt.
#

if ARCH_QDF2400

menu "cortexm4 soc options"

endmenu

config APM
	bool "switch power supply"

config TSENS
	bool "Support tsens"

config CPUCHAR
	bool "Support cpuchar"

endif
```

## drivers/GICv2/Kconfig
```kconfig
#
# IMC_GICv2
#

menuconfig IMC_GICv2
	bool "IMC Generic Interrupt Controller support"
```

## drivers/Kconfig
```kconfig
#
# Firmware Features
#

menu "Feature setup"

menu "Generic kernel features"

config IRQ_FORBIDDEN
	bool

config IRQ_POLL_FORBIDDEN
	bool

choice
	prompt "IRQ handling model"
	default IRQ

config IRQ_POLLING
	bool "Polling IRQs in BH"
	depends !IRQ_POLL_FORBIDDEN
	help
	  No hardware interrupt handlers will be registered, all hardware
	  events are examined through polling.
	  This is a suitable architecture for those bootloaders that would
	  use an unsafe different interrupt vectors from the loaded
	  firmware.

config IRQ
	bool "IRQ interrupted BH"
	depends on !IRQ_FORBIDDEN
	help
	  Hardware interrupt handlers will be registered, while some
	  hardware events will still be implemented in synchronous way.
	  This is a suitable architecture for those firmwares that would
	  expect faster process of interrupts and the firmware itself
	  does not require high resolution realtime responsiveness.

endchoice

config ARCH_HAS_IRQC
	bool

menu "Address space layout (.text) support"

config XIP
	bool "Enable eXecute In Place (XIP) support"

config TEXT_ROM_BASE
	hex "Base offset of the .text section in the ROM"
	default 0
	help
	  In XIP firmware, this could be used in the linker script to
	  determine the load address of the .text section.  While in
	  non-XIP firmware, this might be used to calculate the load
	  address of the variables created in the linker script.

endmenu

menu "Interactive console (term) support"

config CONSOLE_OUTPUT
	bool "Enable console output"

config CONSOLE_INPUT
	bool "Enable console input"

config CONSOLE_COMMAND
	bool "Enable console commands"
	select CONSOLE_OUTPUT
	select CONSOLE_INPUT

choice
	prompt "Debugging output"

config DEBUG_NONE
	bool "None"

config DEBUG_UART
	bool "UART"
	select UART

config DEBUG_DCC
	bool "ARM DCC"
	select DCC if ARM64

endchoice

endmenu

config SMP
	bool "Symmetrical Multi-Processing (SMP)"

config ARCH_HAS_GPIO
	bool


config GPIO
	bool "General purpose Input/Output (GPIO) support"
	depends ARCH_HAS_GPIO

config HEAP_GENERIC
    bool "generic heap supporting"
    default n

config DMM
    bool "Dynamic Memory Management"
    default n
    depends !HEAP_GENERIC

source drivers/ddr/Kconfig
source drivers/uart/Kconfig
source drivers/i2c/Kconfig
source drivers/i2c/dw/Kconfig
source drivers/spi/dw/Kconfig
source drivers/spi/master/Kconfig
source drivers/spi/slave/Kconfig
source drivers/qspi/Kconfig
source drivers/emac/Kconfig
source drivers/XGmac/Kconfig
source drivers/trng/Kconfig
source drivers/pcie/Kconfig
source drivers/sata/Kconfig
source drivers/GICv2/Kconfig
source drivers/sae_smmu/Kconfig
source drivers/arm_smmu/Kconfig
source drivers/ethernet/synopsis/Kconfig
source drivers/clk/Kconfig
source drivers/hidma/Kconfig
source drivers/usb2/Kconfig
source drivers/ufs/Kconfig
source drivers/mmc/Kconfig
source drivers/dwc_mshc/Kconfig
source drivers/libfdt/Kconfig
source drivers/pci/Kconfig
source drivers/d71/Kconfig
source drivers/watchdog/Kconfig
source drivers/dma/ahb/Kconfig
source drivers/crypto/Kconfig
source drivers/mbedtls/library/Kconfig
source drivers/gc355/Kconfig
source drivers/gc520/Kconfig
source drivers/vc8000e/Kconfig
source drivers/vc8000d/Kconfig
source drivers/gdc/Kconfig

endmenu

menu "Advanced kernel features"

config RAS
	bool "Reliability Availability Serviceability (RAS) support"

config PERF
	bool "Performance counting (perf) support"

config SEMIHOST
	bool "enable semihosting"
	default n

config CRC32
	bool "enable crc32 count"
	default n
endmenu

endmenu
```

## drivers/XGmac/Kconfig
```kconfig
#menuconfig XGMAC
#	bool "Ethernet 10GMAC support"

#if HDTS

config XGMAC
	bool "HDTS 10G mac feature support"
	default n

#endif
```

## drivers/arm_smmu/Kconfig
```kconfig
#menuconfig arm_SMMU
#	bool "arm smmu support

config ARM_SMMU
	bool "ARM SMMU feature support"
	default n
```

## drivers/clk/Kconfig
```kconfig
#menuconfig clk_config
#	bool "clk driver config"

config CLK_DRIVER
	bool "clk driver config"
	default n
```
