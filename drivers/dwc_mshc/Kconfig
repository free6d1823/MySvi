## drivers/dwc_mshc/Kconfig
```kconfig
config DWC_MSHC
	bool "DWC_MSHC support"
	---help---
	  DWC_MSHC storage driver.

if DWC_MSHC

config MMC_WRITE
	bool "Synopsys DWC_mshc write support"
	---help---
	  Support Synopsys DWC_mshc.

endif
```

## drivers/emac/Kconfig
```kconfig
#menuconfig EMAC
#	bool "Ethernet MAC support"

#if HDTS

config EMAC
	bool "HDTS EMAC feature support"
	default n

#endif
```

## drivers/ethernet/synopsis/Kconfig
```kconfig
#menuconfig DW_EMAC
#	bool "DW 1G mac support"
config DW_EMAC
	bool "synopsis 1G mac driver support"
	default n
```

## drivers/gpu2/Kconfig
```kconfig
config GPU2
	bool "GC355 and GPU620 support"
	---help---
	  GC355 and GPU620 driver.
```

## drivers/i2c/Kconfig
```kconfig
menuconfig I2C
	bool "Inter-integrated circuit (I2C) support"

if I2C

config I2CS
	bool "I2C slave support"

endif
```

## drivers/mmc/Kconfig
```kconfig
#menuconfig mmc

config MMC
	bool "MMC support"
	---help---
	  MMC storage driver.

if MMC

config DW_EMMC
	bool "Synopsys emmc support"
	---help---
	  Support Synopsys emmc.

endif
```

## drivers/pci/Kconfig
```kconfig
#
# pci enum
#
config PCI
	bool "pci enum"

if PCI

config PCIE_DW
	bool "Synopsys PCIe controller support"
	---help---
		Support Synopsys PCIe controller.

endif
```

## drivers/sae_smmu/Kconfig
```kconfig
#menuconfig SAE_SMMU
#	bool "sae smmu support"

#if SAE_SMMU

config SAE_SMMU
	bool "SAE SMMU feature support"

#endif
```

## drivers/sata/Kconfig
```kconfig
#
# SATA
#

menuconfig SATA
	bool "Serial Advanced Technology Attachment (SATA) support"

if SATA

config HDTS_SATA
    bool "HDTS SATA feature support"

config PWRSOC_SATA
    bool "PWRSOC SATA feature support"

endif
```

## drivers/spi/master/Kconfig
```kconfig
menuconfig SPI
	bool "Inter-integrated circuit (SPI) support"

if SPI

config SPI_NOR
	bool "SPI_nor support"

config AVSBUS
	bool "AVSBUS support"

endif
```

## drivers/trng/Kconfig
```kconfig
menuconfig TRNG
	bool "True Random Number Generator support"

if TRNG

config HDTS_TRNG
	bool "HDTS TRNG feature support"

endif
```
