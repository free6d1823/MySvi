## drivers/uart/Kconfig
```kconfig
#
# UART Devices
#

config ARCH_HAS_UART
	bool

config UART
	bool "Universal asynchronous RX/TX (UART) support"
	depends ARCH_HAS_UART

menu "CoreLink peripherals"

config UART_PL01X
	bool "PrimeCell UART (PL01x)"
	select ARCH_HAS_UART
	help
	  PrimeCell UART (PL010/PL011) offers similar functionality to the
	  industry-standard 16C550 UART.

config UART_DW16550
	bool "Synopsis 16550 uart"
	select ARCH_HAS_UART
	help
	  16550 compatible uart driver

if UART_PL01X || UART_DW16550
choice
	prompt "which UART for debug consoles"
	default UART_PL01X_DEV0
	help
	  Select serial port used for DEBUG_PRINT and CONSOLE.
	  Currently only one device can be selected as CONSOLE


config UART_PL01X_DEV0
	bool "uart device 0"

config UART_PL01X_DEV1
	bool "uart device 1"

config UART_DW16550_DEV0
	bool "uart device 3"

config UART_DW16550_DEV1
	bool "uart device 4"

endchoice
endif

endmenu

if UART

config UART_CON_BAUDRATE
  int "configure console uart baudrate:"
	default 115200

endif
```

## drivers/ufs/Kconfig
```kconfig
config UFS
	bool "UFS support"
	---help---
	  UFS storage driver.

if UFS

config DW_UFS
	bool "Synopsys UFS support"
	---help---
	  Support Synopsys UFS.

endif
```

## drivers/usb2/Kconfig
```kconfig
config USB
	bool "USB support"

if USB

config USB_XHCI_HCD
	bool "xHCI HCD (USB 3.0) support"
	---help---
	  The eXtensible Host Controller Interface (xHCI) is standard for USB 3.0
	  "SuperSpeed" host controller hardware.

config USB_XHCI_PCI
	bool "Support for PCI-based xHCI USB controller"
	depends on USB_XHCI_HCD
	help
	  Enables support for the PCI-based xHCI controller.

config USB_EHCI_HCD
	bool "EHCI HCD (USB 2.0) support"
	---help---
	  The Enhanced Host Controller Interface (EHCI) is standard for USB 2.0
	  "high speed" (480 Mbit/sec, 60 Mbyte/sec) host controller hardware.
	  If your USB host controller supports USB 2.0, you will likely want to
	  configure this Host Controller Driver.

	  EHCI controllers are packaged with "companion" host controllers (OHCI
	  or UHCI) to handle USB 1.1 devices connected to root hub ports.  Ports
	  will connect to EHCI if the device is high speed, otherwise they
	  connect to a companion controller.  If you configure EHCI, you should
	  probably configure the OHCI (for NEC and some other vendors) USB Host
	  Controller Driver or UHCI (for Via motherboards) Host Controller
	  Driver too.

config USB_STORAGE
	bool "USB storage support"
	---help---
	  USB storage driver.


config USB_DWC2
	bool "DesignWare USB2 Core support"
	---help---
	  The DesignWare USB 2.0 controller is compliant with the
	  USB-Implementers Forum (USB-IF) USB 2.0 specifications.
	  Hi-Speed (480 Mbps), Full-Speed (12 Mbps), and Low-Speed (1.5 Mbps)
	  operation is compliant to the controller Supplement. If you want to
	  enable this controller in host mode, say Y.

if USB_DWC2
config USB_DWC2_BUFFER_SIZE
	int "Data buffer size in kB"
	default 64
	---help---
	  By default 64 kB buffer is used but if amount of RAM avaialble on
	  the target is not enough to accommodate allocation of buffer of
	  that size it is possible to shrink it. Smaller sizes should be fine
	  because larger transactions could be split in smaller ones.

endif # USB_DWC2

config USB_DWC2_DEVICE
	bool "DesignWare USB2 Device support"
	---help---
	  The DesignWare USB 2.0 controller is compliant with the
	  USB-Implementers Forum (USB-IF) USB 2.0 specifications.
	  Hi-Speed (480 Mbps), Full-Speed (12 Mbps), and Low-Speed (1.5 Mbps)
	  operation is compliant to the controller Supplement. If you want to
	  enable this controller in device mode, say Y.

endif
```

## drivers/watchdog/Kconfig
```kconfig
config DW_WDT
	bool "designware wdt driver"

config SUPPORT_SPU_WDT
  int "configure power manage private wdt indx"
	default 0
```

## init/Kconfig
```kconfig
#
# For a description of the syntax of this configuration file,
# see scripts/kbuild/config-language.txt.
#

menu 'Generic setup'

config EXPERIMENTAL
	bool "Prompt for development"
	help
	  Some of the various things that HVEP supports can be in a state
	  of development where the functionality, stability, or the level of
	  testing is not yet high enough for general use. This is usually
	  known as the "alpha-test" phase among developers. If a feature is
	  currently in alpha-test, then the developers usually discourage
	  uninformed widespread use of this feature by the general public to
	  avoid "Why doesn't this work?" type mail messages. However, active
	  testing and use of these systems is welcomed. Just be aware that it
	  may not meet the normal level of reliability or it may fail to work
	  in some special cases. Detailed bug reports from people familiar
	  with the kernel internals are usually welcomed by the developers
	  This option will also make obsoleted drivers available. These are
	  drivers that have been replaced by something else, and/or are
	  scheduled to be removed in a future kernel release.
	  Unless you intend to help test and develop a feature or driver that
	  falls into this category, or you have a situation that requires
	  using these features, you should probably say N here, which will
	  cause the configurator to present you with fewer choices. If
	  you say Y here, you will be offered the choice of using features or
	  drivers that are currently considered to be in the alpha-test phase.

config BSS_IN_DATA
	bool "Allocate BSS in DATA section"
	depends EXPERIMENTAL
	default n
	help
	  Normally BSS will be allocated in the BSS section and BSS will be
	  cleared at startup. This option will allocate BSS in DATA section.
	  It will increase the size of image. Anyway, the time will be saved
	  at startup because clearing BSS is not needed.

config CC_OPT_SIZE
	bool "Optimize for size"
	default y
	help
	  Enabling this option will pass "-Os" to compiler resulting in a
	  smaller kernel.
	  If unsure, say N.

config CC_OPT_SPEED
	bool "Optimize for speed"
	default y
	help
	  Enabling this option will pass "-O2" to compiler resulting in a
	  faster kernel.
	  If unsure, say N.

menuconfig DEBUG
	bool 'Debugging options'
	depends EXPERIMENTAL

if DEBUG

config CC_GEN_DEBUG
	bool "Compile with debug info"
	help
          If you say Y here the resulting kernel image will include
	  debugging info resulting in a larger kernel image.
	  This adds debug symbols to the kernel and modules (gcc -g), and
	  is needed if you intend to use kernel crashdump or binary object
	  tools like crash, kgdb, LKCD, gdb, etc on the kernel.
	  Say Y here only if you plan to debug the kernel.

	  If unsure, say N.

endif

config CPU_MASK
	hex "configure cpu mask (0x1-0xffffffffffff)"
	default "0xffffffffffff" if TESTOS_HWP
	default "0x3f" if (PRE_Z1 || PRE_S1 || PRE_HAPS)
	default "0xffffffffffff"

config LLC_MASK
	hex "configure last level cache mask (0x1-0xffffff)"
	default "0xffffff" if (TESTOS_HWP || PRE_Z1)
	default "0xf" if (PRE_S1 || PRE_HAPS)
	default "0xffffff"

endmenu
```

## init/Kconfig.main
```kconfig
#
# For a description of the syntax of this configuration file,
# see scripts/kbuild/config-language.txt.
#

menu "Program setup"

config TESTOS
	bool
	select MMU
	select GPIO

choice
	prompt "Target Program"
	default PWRSOC

config M4BENCH
	bool "Cortex-m4 Bench"
	select CONSOLE_COMMAND
	help
	  This option is used to run patterns in an interactive command
	  line environment, which requires special configurations that are
	  conflict to what are used for building standalone patters.
	  The hvep image built by this option should always include
	  console inputs.

config PWRSOC
	bool "Power Bench"
	select CONSOLE_COMMAND
	select MMU
	select TCM if ARCH_QDF2400
	help
	  This option is used to run patterns in an interactive command
	  line environment, which requires special configurations that are
	  conflict to what are used for building standalone patters.
	  The hvep image built by this option should always include
	  console inputs.

config TESTOS_COMBINED
	bool "TestOS combined IMC/APC"
	select SMP
	select TESTOS
	help
	  This option is used to run patterns in standalone styles.
	  The hvep image built by this option may not include console
	  inputs.

endchoice

choice
	prompt "Target platform"
	default TESTOS_HWP

config TESTOS_HWP
	bool "Real hardware platforms (SDP/REP)"
	select UART
	select PMIC_SPMI
	select PMIC_PMBUS

config TESTOS_DBG
	bool "Real hardware platform with debugger (T32)"
	select DCC
	select PMIC_SPMI
	select PMIC_PMBUS

config TESTOS_EMU
	bool "Emulators"

config TESTOS_ATE
	bool "Testers (ATE/Bench)"

endchoice

if TESTOS_EMU

choice
	prompt "Emulator type"

config PRE_Z1
	bool "Palladium Z1"

config PRE_S1
	bool "Prodium S1"

config PRE_HAPS
	bool "Synopsys HAPS"

endchoice

endif

source "init/pwrsoc/Kconfig"
source "init/testos/Kconfig"
source "init/m4bench/Kconfig"

endmenu
```

## init/m4bench/Kconfig
```kconfig
if M4BENCH

menu "Cortex-m4 bench options"

menuconfig M4_BENCH
	bool "Enable bench support"

endmenu

endif
```

## init/pwrsoc/Kconfig
```kconfig
if PWRSOC

menu "Pwrsoc options"

menuconfig PWRSOC_BENCH
	bool "Enable bench support"

if PWRSOC_BENCH

config PWRSOC_POWERVIRUS
       bool "Enable powervirus support"

config PWRSOC_ATOMICTEST
       bool "Enable atomic test patterns"

endif

endmenu

endif
```

## init/testos/Kconfig
```kconfig
if TESTOS

menu "TestOS options"

config TESTOS_PATTERN
	bool "Enable standalone patterns"
	help
	  TestOS allows patterns to be linked as standalone programs.
	  Without enabling this options, HVEP only compiles one
	  program - an interactive TestOS console.

if TESTOS_PATTERN

menu "Benchmark patterns"

config TESTOS_DHRYSTONE
	bool "Standalone dhrystone pattern"
	select DHRYSTONE

config TESTOS_LINPACK
	bool "Standalone linpack pattern"
	select LINPACK

config TESTOS_LINPACK_TIMEOUT
	int "Linpack running timeout"
	depends TESTOS_LINPACK
	range -1 30000000
	default 5000 if TESTOS

config TESTOS_SAXPY
	bool "Standalone saxpy pattern"
	select SAXPY

config TESTOS_QPOWER
	bool "Standalone qpower (power virus) pattern"
	depends ARM64
	select QPOWER

endmenu

menu "Readiness test patterns"

config TESTOS_ATEINIT
	bool "ATE IMC dispatcher"
	help
	  Demonstrate ATE pattern dispatching via IMC.
	  ATE programmer can re-program next pattern address via
	  ate_setup structure, and ate_setup change monitor running
	  on IMC can notice the change and re-dispatch the pattern.

config TESTOS_GLKTEST
	bool "ACPI global lock emulation"
	depends DEBUG_DCC
	select CONSOLE_IMC_BUFFERING

config TESTOS_TCMTEST
	bool "TCM memory accessibility"
	depends TCM
	select TCMTEST

config TESTOS_ASMPERCPU
	bool "Assmebly percpu API readiness"
	depends SMP
	select ASMPERCPU

config TESTOS_MEMRAND
	bool "Random memory access"
	depends TCM
	select MEMRAND

config TESTOS_ARM64ISA
	bool "ARM64 ISA converity"
	depends ARM64
	select RAVEN

endmenu

endif

endmenu

endif
```

## lib/Kconfig
```kconfig
#
# Library Features
#

menu "Library setup"

config CRC16_CCITT
        bool "Enable crc16"

config COMMON_C_LIB
        bool "Enable common C lib for memmove function"
        default n

config MEM_FUNC_OPTIMIZE
	bool "Optimize memmove, memset and memcpy"

endmenu
```

## tests/Kconfig
```kconfig
#
# Firmware Tests
#

menu "Test setup"

config TEST_VERBOSE
	bool "Enable verbosity in tests"

source tests/bench/Kconfig
source tests/sanity/Kconfig
source tests/raven/Kconfig

endmenu
```

## tests/bench/Kconfig
```kconfig
menu "Standard benchmarks tests"

config PATTERN_BENCHMARK
	bool

config BENCH_OPTIMIZED
	depends PATTERN_BENCHMARK
	depends !CC_OPT_SPEED
	bool "Build bench tests with -O2"

config DHRYSTONE
	bool "Dhrystone"
	select TCM
	select PATTERN_BENCHMARK

config DHRYSTONE_TIMEOUT
	int "Dhrystone timeout (usecs)"
	depends DHRYSTONE
	range -1 1000000
	default -1 if TESTOS

config DHRYSTONE_REPEATS
	int "Dhyrstone number of runs"
	depends DHRYSTONE
	range 5000 5000000
	default 5000 if TESTOS

config DHRYSTONE_SPECIFIC_PERCPU
	bool "Use dhrystone specific PERCPU mechanism"

config LINPACK
	bool "Linpack"
	select TCM
	select PATTERN_BENCHMARK

config LINPACK_CALIBRATION_TIMEOUT
	int "Linpack calibration timeout (usecs)"
	depends LINPACK
	range 1 1000000
	default 1 if TESTOS

config LINPACK_CALIBRATION_REPEATS
	int "Linpack calibration repeats"
	depends LINPACK
	range 1 10
	default 1 if TESTOS

config LINPACK_SPECIFIC_PERCPU
	bool "Use linpack specific PERCPU mechanism"

config SAXPY
	bool "Saxpy"
	select PATTERN_BENCHMARK

if SAXPY

config SAXPY_SIZE
	int "Saxpy array size"
	range 2 81920
	default 81920 if TCM

config SAXPY_EXPECT
	bool "Sanity check saxpy results"
	depends EXPERIMENTAL
	help
	  This requires very large percpu area.
	  If unsure, say 'N'

config SAXPY_TIMEOUT
	int "Saxpy timeout (usecs)"
	depends SAXPY
	range -1 1000000
	default 1000000 if !TESTOS
	default 50000 if TESTOS

config SAXPY_REPEATS
	int "Saxpy number of runs"
	depends SAXPY
	range -1 5000000
	default 50000 if !TESTOS
	default -1 if TESTOS

endif

config QPOWER
	bool "Power virus (QPower)"
	depends ARM64

if QPOWER

config QPOWER_TIMEOUT
	int "QPower timeout (usecs)"
	depends QPOWER
	range -1 1000000
	default 1000000

config QPOWER_REPEATS
	int "QPower number of runs"
	depends QPOWER
	range -1 5000000
	default 50000

endif

config HPOWER10
	bool "Power virus (HPower 1.0)"
	depends ARM64

endmenu
```

## tests/sanity/Kconfig
```kconfig
menu "Kernel feature sanity validations"

config SPINLOCK_TEST
	bool "Spinlock test"

config TCMTEST
	bool "TCM integrity validation"
	depends TCM

config ASMPERCPU
	bool "ASM PERCPU API validation"
	depends SMP

config MEMRAND
	bool "Random memory access stress test"
	depends TCM

if MEMRAND

choice
	prompt "Cache hit/miss"

config MEMRAND_L1HIT
	bool "L1 hit"

config MEMRAND_L1MISS
	bool "L1 miss"

endchoice

endif

endmenu
```
